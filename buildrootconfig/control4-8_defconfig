## buildrootconfig/control4-8_defconfig
```kconfig
BR2_arm=y
BR2_TOOLCHAIN_BUILDROOT_GLIBC=y
BR2_TARGET_GENERIC_HOSTNAME="control4-8"
BR2_TARGET_GENERIC_ISSUE="Welcome to Hansong Linux"
BR2_TARGET_GENERIC_ROOT_PASSWD="root"
BR2_SYSTEM_DHCP="eth0"

BR2_LOCALFILES="cp"
BR2_SSH="ssh"
BR2_SCP="scp"
BR2_PACKAGE_MTD=y
# BR2_PACKAGE_MTD_FLASHCP is not set
# BR2_PACKAGE_MTD_FLASH_LOCK is not set
# BR2_PACKAGE_MTD_FLASH_UNLOCK is not set
# BR2_PACKAGE_MTD_MTD_DEBUG is not set
# BR2_PACKAGE_MTD_NANDTEST is not set
# BR2_PACKAGE_MTD_MTDINFO is not set
# BR2_PACKAGE_MTD_UBIATTACH is not set
# BR2_PACKAGE_MTD_UBICRC32 is not set
# BR2_PACKAGE_MTD_UBIDETACH is not set
# BR2_PACKAGE_MTD_UBIFORMAT is not set
# BR2_PACKAGE_MTD_UBIMKVOL is not set
# BR2_PACKAGE_MTD_UBINFO is not set
# BR2_PACKAGE_MTD_UBINIZE is not set
# BR2_PACKAGE_MTD_UBIRENAME is not set
# BR2_PACKAGE_MTD_UBIRMVOL is not set
# BR2_PACKAGE_MTD_UBIRSVOL is not set
# BR2_PACKAGE_MTD_UBIUPDATEVOL is not set
# BR2_PACKAGE_MTD_UBIBLOCK is not set
BR2_PACKAGE_RNG_TOOLS=y
BR2_PACKAGE_LIBFCGI=y
BR2_PACKAGE_NGINX=y
BR2_PACKAGE_NGINX_UPLOAD=y
BR2_PACKAGE_NTP=y
BR2_PACKAGE_OPENSSH=y
BR2_PACKAGE_SPAWN_FCGI=y
BR2_TARGET_ROOTFS_JFFS2=y
BR2_PACKAGE_PHP=y
BR2_PACKAGE_PHP_EXT_JSON=y
BR2_TARGET_ROOTFS_JFFS2_NANDFLASH_128K=y
```

## buildrootconfig/ctrl16d_defconfig
```kconfig
# Architure armv5 core
BR2_arm=y
BR2_arm926t=y

# System
BR2_SYSTEM_DHCP="eth0"

#
BR2_LINUX_KERNEL=n
BR2_KERNEL_HEADERS_3_10=y

# Filesystem
BR2_TARGET_ROOTFS_SQUASHFS=y
#BR2_TARGET_ROOTFS_YAFFS2=y

BR2_LOCALFILES="cp"
BR2_SSH="ssh"
BR2_SCP="scp"
#BR2_SYSTEM_STANDALONE_TELNETD=y
#BR2_PACKAGE_BUSYBOX_STANDALONE_TELNETD=y
BR2_TOOLCHAIN_BUILDROOT_GLIBC=y
#BR2_PACKAGE_ATFTP=y
BR2_PACKAGE_GLIBC=y

BR2_PACKAGE_NGINX=y
BR2_PACKAGE_NGINX_HTTP=y
BR2_PACKAGE_NGINX_UPLOAD=y

#BR2_PACKAGE_PHP=y
#BR2_PACKAGE_PHP_EXT_JSON=y

# Do not use above PHP any more...use FastCGI instead
BR2_PACKAGE_LIBFCGI=y
BR2_PACKAGE_SPAWN_FCGI=y

# IMPORTANT - below package can't be added
# as ovrc strictly depends on older SSL related lib
#BR2_PACKAGE_LIBCURL=y
#BR2_PACKAGE_LIBWEBSOCKETS=y
#BR2_PACKAGE_OPENSSL=y

BR2_PACKAGE_OPENSSH=y

# ALSA 
BR2_PACKAGE_ALSA_UTILS=y
BR2_PACKAGE_ALSA_LIB=y
BR2_PACKAGE_ALSA_UTILS_APLAY=y

# NTP
BR2_PACKAGE_NTP=y

BR2_TARGET_GENERIC_HOSTNAME="ctrl16d"
BR2_TARGET_GENERIC_ISSUE="Welcome to Hansong Linux"
```

## buildrootconfig/spa25_defconfig
```kconfig
# Architure armv5 core
BR2_arm=y
BR2_arm926t=y

# System
BR2_SYSTEM_DHCP="eth0"

#
BR2_LINUX_KERNEL=n
BR2_KERNEL_HEADERS_3_10=y

# Filesystem
BR2_TARGET_ROOTFS_SQUASHFS=y
#BR2_TARGET_ROOTFS_YAFFS2=y

BR2_LOCALFILES="cp"
BR2_SSH="ssh"
BR2_SCP="scp"

#BR2_SYSTEM_STANDALONE_TELNETD=y
BR2_PACKAGE_BUSYBOX_STANDALONE_TELNETD=y

BR2_TOOLCHAIN_BUILDROOT_GLIBC=y
BR2_PACKAGE_ATFTP=y
BR2_PACKAGE_GLIBC=y
BR2_PACKAGE_NGINX=y
BR2_PACKAGE_OPENSSL=y
```
